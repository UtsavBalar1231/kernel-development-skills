## plugins/kernel-development-skills/evals/files/e4-bsp-tree/arch/arm64/configs/acme_defconfig
```kconfig
CONFIG_ARCH_ACME=y
CONFIG_SMP=y
CONFIG_HWMON=y
CONFIG_THERMAL=y
CONFIG_THERMAL_OF=y
CONFIG_SERIAL_8250=y
CONFIG_SERIAL_8250_CONSOLE=y
```

## plugins/kernel-development-skills/evals/files/e4-bsp-tree/drivers/hwmon/Kconfig
```kconfig
# Excerpt

config SENSORS_PWM_FAN
	tristate "PWM fan"
	depends on PWM || COMPILE_TEST
	depends on THERMAL || THERMAL=n
	help
	  If you say yes here you get support for fans connected to PWM lines.
	  The driver uses the generic PWM interface, thus it will work on a
	  variety of SoCs.

	  This driver can also be built as a module. If so, the module
	  will be called pwm-fan.
```
